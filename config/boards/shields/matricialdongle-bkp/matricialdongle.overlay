/*
 * Copyright (c) 2020 The ZMK Contributors
 *
 * SPDX-License-Identifier: MIT
 */

#include "matricialdongle.dtsi"

/ {
    model = "mdongle";
    compatible = "mdongle";

    chosen {
        zmk,split = &split;
    };

    split: split {
        compatible = "zmk,split";
        label = "SPLIT";
    };
};