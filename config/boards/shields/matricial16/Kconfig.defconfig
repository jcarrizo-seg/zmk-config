## config/boards/shields/matricial16/Kconfig.defconfig
```kconfig
if SHIELD_MATRICIAL16

# Name must be less than 16 characters long!
config ZMK_KEYBOARD_NAME
    default "Matricial 16"

endif
```

## config/boards/shields/matricialdongle-bkp/matricialdongle.defconfig
```kconfig
# Copyright (c) 2020 The ZMK Contributors
# SPDX-License-Identifier: MIT

CONFIG_ZMK_KEYBOARD_NAME="Matricial Split Dongle"

# Configuración para dongle central
CONFIG_ZMK_SPLIT=y
CONFIG_ZMK_SPLIT_ROLE_CENTRAL=y
CONFIG_ZMK_BLE=y

# Sin matriz física propia
CONFIG_ZMK_KSCAN_MOCK_DRIVER=y

# USB siempre habilitado
CONFIG_ZMK_USB=y
```

## config/boards/shields/matricialdongle/Kconfig.defconfig
```kconfig
if SHIELD_MATRICIALDONGLE
    config ZMK_KEYBOARD_NAME
        default "MatSplit Dongle"
endif

if SHIELD_MATRICIALDONGLE_LEFT
    config ZMK_KEYBOARD_NAME
        default "MatSplit L"
endif

if SHIELD_MATRICIALDONGLE_RIGHT  
    config ZMK_KEYBOARD_NAME
        default "MatSplit R"
endif

if SHIELD_MATRICIALDONGLE || SHIELD_MATRICIALDONGLE_LEFT || SHIELD_MATRICIALDONGLE_RIGHT
    config ZMK_SPLIT
        default y
        
    config ZMK_BLE
        default y
endif
```

## config/boards/shields/matricialdongle/Kconfig.shield
```kconfig
config SHIELD_MATRICIALDONGLE
    def_bool $(shields_list_contains,matricialdongle)
    select ZMK_SPLIT
    select ZMK_SPLIT_ROLE_CENTRAL

config SHIELD_MATRICIALDONGLE_LEFT
    def_bool $(shields_list_contains,matricialdongle_left)
    
config SHIELD_MATRICIALDONGLE_RIGHT  
    def_bool $(shields_list_contains,matricialdongle_right)
```

## config/boards/shields/matricialsplit/Kconfig.defconfig
```kconfig
if SHIELD_MATRICIALSPLIT_LEFT

# Name must be less than 16 characters long!
config ZMK_KEYBOARD_NAME
    default "Matricial Split"

config ZMK_SPLIT_ROLE_CENTRAL
    default y

endif

if SHIELD_MATRICIALSPLIT_LEFT || SHIELD_MATRICIALSPLIT_RIGHT

config ZMK_SPLIT
    default y

endif

# Kconfig.defconfig para Battery Status LEDs Module
# Archivo: config/boards/shields/mi_teclado/Kconfig.defconfig

# Configuración por defecto cuando se usa este shield

if SHIELD_MATRICIALSPLIT_LEFT

# Habilitar dependencias requeridas para Battery Status LEDs
config ZMK_BATTERY_REPORTING
    default y

config GPIO
    default y

config LOG
    default n

# Configuración específica para el módulo (opcional)
config ZMK_BATTERY_STATUS_LEDS
    bool "Enable Battery Status LEDs"
    default y
    depends on ZMK_BATTERY_REPORTING && GPIO
    help
      Enable battery status indication using individual LEDs.
      Requires red-gpio, green-gpio, and blue-gpio to be defined
      in devicetree under battery_status_leds node.

endif # SHIELD_MATRICIALSPLIT_LEFT
```

## config/boards/shields/matricialsplit/Kconfig.shield
```kconfig
# No whitespace after the comma or in the keyboard name!
config SHIELD_MATRICIALSPLIT_LEFT
    def_bool $(shields_list_contains,matricialsplit_left)

config SHIELD_MATRICIALSPLIT_RIGHT
    def_bool $(shields_list_contains,matricialsplit_right)

config SHIELD_MATRICIALSPLIT_DONGLE
    def_bool $(shields_list_contains,matricialsplit_dongle)
```

## config/boards/shields/matricialsplit/dongle/Kconfig.defconfig
```kconfig
# Configuración por defecto para los shields del dongle

# Configuración del dongle central
if SHIELD_MATRICIALSPLIT_DONGLE

# Nombre del teclado (debe ser menos de 16 caracteres)
config ZMK_KEYBOARD_NAME
    default "Mat Dongle"

# El dongle es el dispositivo central del split
config ZMK_SPLIT_ROLE_CENTRAL
    default y

# Habilitar funcionalidad split
config ZMK_SPLIT
    default y

endif

# Configuración para periféricos izquierdo y derecho
if SHIELD_MATRICIALSPLIT_PERIPHERAL_LEFT || SHIELD_MATRICIALSPLIT_PERIPHERAL_RIGHT

# Los periféricos NO son centrales (son periféricos)
config ZMK_SPLIT_ROLE_CENTRAL
    default n

# Habilitar funcionalidad split
config ZMK_SPLIT
    default y

# Los periféricos usan BLE para comunicarse con el dongle
config ZMK_SPLIT_BLE
    default y

endif
```

## config/boards/shields/matricialsplit/dts/bindings/zmk,battery-status-leds.yaml
```yaml
# Device Tree Binding para Battery Status LEDs
# Archivo: config/boards/shields/mi_teclado/dts/bindings/zmk,battery-status-leds.yaml

description: |
  Battery Status LEDs Indicator for ZMK
  
  This binding defines a battery status indicator using individual LEDs
  to show battery level and charging status.
  
  LED States:
  - No battery sensor: Green LED (constant)  
  - Battery low (< low-threshold, no USB): Blue LED (constant)
  - Battery OK (>= low-threshold, no USB): All LEDs off
  - Charging (< full-threshold, USB connected): Red LED (constant)
  - Charged (>= full-threshold, USB connected): Green LED (constant)

compatible: "zmk,battery-status-leds"

properties:
  red-gpios:
    type: phandle-array
    required: true
    description: |
      GPIO for red LED (used for charging indication)
      Example: red-gpios = <&gpio1 4 GPIO_ACTIVE_HIGH>;

  green-gpios:
    type: phandle-array  
    required: true
    description: |
      GPIO for green LED (used for charged/no-battery indication)
      Example: green-gpios = <&gpio1 6 GPIO_ACTIVE_HIGH>;

  blue-gpios:
    type: phandle-array
    required: true  
    description: |
      GPIO for blue LED (used for low battery indication)
      Example: blue-gpios = <&gpio1 11 GPIO_ACTIVE_HIGH>;

  low-threshold:
    type: int
    default: 90
    description: |
      Battery level threshold for low battery indication (in percentage).
      When battery level falls below this value (and USB not connected),
      blue LED will be activated.
      Valid range: 5-40. Must be at least 10% less than full-threshold.

  full-threshold:
    type: int
    default: 5
    description: |
      Battery level threshold for full battery indication (in percentage).
      When battery level reaches this value (and USB connected),
      green LED will be activated instead of red charging LED.
      Valid range: 60-100. Must be at least 10% more than low-threshold.
```

## config/boards/shields/matricialsplit_dongle/Kconfig.defconfig
```kconfig
# Configuración por defecto para los shields del dongle

# Configuración del dongle central
if SHIELD_MATRICIALSPLIT_DONGLE

# Nombre del teclado (debe ser menos de 16 caracteres)
config ZMK_KEYBOARD_NAME
    default "Mat Dongle"

# El dongle es el dispositivo central del split
config ZMK_SPLIT_ROLE_CENTRAL
    default y

# Habilitar funcionalidad split
config ZMK_SPLIT
    default y

# Habilitar BLE para comunicarse con periféricos
# config ZMK_BLE
#     default y

# Set this to the number of peripherals your dongle will have.
# For a unibody, this would be 1. If you have left and right halves, set it to 2, etc.
config ZMK_SPLIT_BLE_CENTRAL_PERIPHERALS
    default 2

# Set this to ZMK_SPLIT_BLE_CENTRAL_PERIPHERALS + your desired number of BT profiles (default is 5)
config BT_MAX_CONN
    default 5

# Set this to the same number as BT_MAX_CONN
config BT_MAX_PAIRED
    default 5

endif

# Configuración para periférico izquierdo
if SHIELD_MATRICIALSPLIT_PERIPHERAL_LEFT

# Nombre específico para el periférico izquierdo
config ZMK_KEYBOARD_NAME
    default "Mat Left"

# Los periféricos NO son centrales
config ZMK_SPLIT_ROLE_CENTRAL
    default n

# Habilitar funcionalidad split
config ZMK_SPLIT
    default y

# Los periféricos usan BLE para comunicarse con el dongle
config ZMK_BLE
    default y

endif

# Configuración para periférico derecho
if SHIELD_MATRICIALSPLIT_PERIPHERAL_RIGHT

# Nombre específico para el periférico derecho
config ZMK_KEYBOARD_NAME
    default "Mat Right"

# Los periféricos NO son centrales
config ZMK_SPLIT_ROLE_CENTRAL
    default n

# Habilitar funcionalidad split
config ZMK_SPLIT
    default y

# Los periféricos usan BLE para comunicarse con el dongle
config ZMK_BLE
    default y

endif
```

## config/boards/shields/matricialsplit_dongle/Kconfig.shield
```kconfig
# Matricial Split Dongle Shields Configuration

# Dongle central - recibe de ambos periféricos y se conecta al host
config SHIELD_MATRICIALSPLIT_DONGLE
    def_bool $(shields_list_contains,matricialsplit_dongle)

# Lado izquierdo como periférico - solo reporta teclas al dongle
config SHIELD_MATRICIALSPLIT_PERIPHERAL_LEFT
    def_bool $(shields_list_contains,matricialsplit_peripheral_left)

# Lado derecho como periférico - solo reporta teclas al dongle
config SHIELD_MATRICIALSPLIT_PERIPHERAL_RIGHT
    def_bool $(shields_list_contains,matricialsplit_peripheral_right)
```

## config/boards/shields/mysofle/Kconfig.defconfig
```kconfig
if SHIELD_MYSOFLE_LEFT

# Name must be less than 16 characters long!
config ZMK_KEYBOARD_NAME
    default "TEST NUEVO"

config ZMK_SPLIT_ROLE_CENTRAL
    default y

endif

if SHIELD_MYSOFLE_LEFT || SHIELD_MYSOFLE_RIGHT

config ZMK_SPLIT
    default y

endif
```

## config/boards/shields/mysofle/Kconfig.shield
```kconfig
# No whitespace after the comma or in your part name!
config SHIELD_MYSOFLE_LEFT
    def_bool $(shields_list_contains,mysofle_left)

# No whitespace after the comma or in your part name!
config SHIELD_MYSOFLE_RIGHT
    def_bool $(shields_list_contains,mysofle_right)
```

## config/boards/shields/single/Kconfig.shield
```kconfig
# No whitespace after the comma or in your part name!
config SHIELD_SINGLE
    def_bool $(shields_list_contains,single)
```

## config/boards/shields/sofle/Kconfig.shield
```kconfig
# No whitespace after the comma or in your part name!
config SHIELD_SOFLE_LEFT
    def_bool $(shields_list_contains,sofle_left)

# No whitespace after the comma or in your part name!
config SHIELD_SOFLE_RIGHT
    def_bool $(shields_list_contains,sofle_right)
```

## modules/usb-led/Kconfig
```kconfig
config ZMK_USB_LED
    bool "USB LED indicator"
    default n
    depends on GPIO
    help
      Enable USB connection LED indicator using red LED
```
