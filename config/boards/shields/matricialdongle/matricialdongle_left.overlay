#include "../matricialsplit/matricialsplit_left.overlay"

// Solo sobrescribir la configuración de split para ser peripheral
&split {
    central-side = <&dongle_side>;  // El dongle es central ahora
    
    dongle_side: dongle_side {
        compatible = "zmk,split-side";
        label = "DONGLE_SIDE";
    };
};